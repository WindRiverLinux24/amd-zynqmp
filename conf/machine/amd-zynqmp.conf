## conf/machine/amd-zynqmp.conf
```bitbake
#@TYPE: Machine
#@NAME: amd-zynqmp
#@DESCRIPTION: Machine configuration for Zynq Ultrascale+ MPSoC

DEFAULTTUNE = "cortexa53"
WRL_ZYNQMP_BOOTBIN_TARGET ??= ""
require ${@bb.utils.contains_any('WRL_ZYNQMP_BOOTBIN_TARGET', 'zcu102', \
		'conf/machine/zcu102-zynqmp.conf', \
		'conf/machine/include/arm/armv8a/tune-cortexa53.inc', d)}

# To eliminate the annoying output by meta-xilinx-standalone/classes/sanity-meta-xilinx-standalone.bbclass
XILINX_WITH_ESW ?= "xsct"

BSP_XILINX_DERIVED:append = " amd-zynqmp"
MACHINE_FEATURES += "ext3 pci usbgadget usbhost vfat keyboard network"
EXTRA_IMAGECMD:jffs2 = "--pad --no-cleanmarkers --eraseblock=128"

KERNEL_IMAGETYPE ?= "Image"
KERNEL_DEVICETREE = "xilinx/zynqmp-zcu102-rev1.0.dtb"

PREFERRED_PROVIDER_virtual/kernel ??= "linux-yocto"
PREFERRED_VERSION_linux-yocto ?= "6.6%"
PREFERRED_VERSION_linux-yocto-rt ?= "6.6%"

MACHINE_EXTRA_RRECOMMENDS = " kernel-modules kernel-devicetree"
IMAGE_FSTYPES += "tar.bz2 wic wic.bmap"

# wic support
IMAGE_INSTALL:append = " kernel-devicetree kernel-image-image"
WKS_FILE ?= "zynqmp-sdimage.wks"
do_image_wic[depends] += "mtools-native:do_populate_sysroot dosfstools-native:do_populate_sysroot"
IMAGE_BOOT_FILES ?= "Image zynqmp-zcu102-rev1.0.dtb"

# multilib support
MULTILIBS ?= "${@bb.utils.contains_any('MACHINE_FEATURES', 'mali400 xilinx-bootbin', '', 'multilib:lib32', d)}"
DEFAULTTUNE:virtclass-multilib-lib32 ?= "armv7athf-neon"
```

## conf/machine/zynqmp-ostree.inc
```bitbake
OSTREE_BOOTLOADER_INCLUDE ?= ""
OSTREE_SD_UBOOT_WIC1 ?= ""
OSTREE_SD_BOOT_ALIGN ?= "4096"
OSTREE_FDISK_BLM ?= "8192"
OSTREE_FDISK_FSZ ?= "132"
OSTREE_KERNEL ?= "Image"
OSTREE_UBOOT_CMD ?= "booti"
OSTREE_WKS_EFI_SIZE ?= "--size=64M"
INSTAB ?= "1"
DEFAULT_DTB ?= "zynqmp-zcu102-rev1.0.dtb"
OSTREE_NETINST_DEV ?= "/dev/mmcblk0,/dev/sda,/dev/vda"
OSTREE_NETINST_ARGS ?= "${OSTREE_CONSOLE} bl=ufsd rdinit=/install instdev=${OSTREE_NETINST_DEV} instname=wrlinux instbr=\$BRANCH insturl=\$URL instab=${OSTREE_USE_AB} instsf=1 instdate=BUILD_DATE"
OSTREE_COPY_IMAGE_BOOT_FILES = "1"
INITRAMFS_IMAGE ??= ""

# Avoid the definition "devicetree/*.dtbo;devicetree/" of IMAGE_BOOT_FILES in meta-xilinx to
# break do_image_otaimg.
IMAGE_BOOT_FILES = " Image zynqmp-zcu102-rev1.0.dtb boot.scr ${INITRAMFS_IMAGE}-${MACHINE}.${INITRAMFS_FSTYPES};initramfs "
IMAGE_BOOT_FILES:append = "${@bb.utils.contains_any('WRL_ZYNQMP_BOOTBIN_TARGET', 'zcu102', ' boot.bin', '', d)}"

OSTREE_BOOTSCR_PRECMD ?= "\
setenv no_menu yes; \
setenv initrd_addr 0x40000000; \
setenv fdt_addr 0xe0000; \
setenv console ttyPS0; \
setenv baudrate 115200n8; \
"
```
