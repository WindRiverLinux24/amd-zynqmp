## conf/layer.conf
```bitbake
#
# Copyright (C) 2023 Wind River Systems, Inc.
#

# We have a conf and classes directory, add to BBPATH
BBPATH =. "${LAYERDIR}:"

# We have a packages directory, add to BBFILES
BBFILES += "${LAYERDIR}/recipes-*/*/*.bb \
	${LAYERDIR}/recipes-*/*/*.bbappend"

# Mask recipes-bsp directory while building a non-amd-zynqmp project.
# Note that BSP_XILINX_DERIVED is defined to be amd-zynqmp in conf/machine/amd-zynqmp.inc
BBMASK += "${@bb.utils.contains_any('MACHINE', '${BSP_XILINX_DERIVED}', '', '${LAYERDIR}/recipes-bsp/', d)}"

HDF_MACHINE:amd-zynqmp ?= "zcu102-zynqmp"
BBFILE_COLLECTIONS += "wr-amd-zynqmp"
BBFILE_PATTERN_wr-amd-zynqmp := "^${LAYERDIR}/"
BBFILE_PRIORITY_wr-amd-zynqmp = "7"

# This should only be incremented on significant changes that will
# cause compatibility issues with other layers
LAYERVERSION_wr-amd-zynqmp = "1"

LAYERDEPENDS_wr-amd-zynqmp = "core wrlinux xilinx-tools xilinx"
LAYERSERIES_COMPAT_wr-amd-zynqmp = "wrl mickledore scarthgap"

LAYER_PATH_wr-amd-zynqmp = "${LAYERDIR}"
```
